#include <SPI.h>  
#include <Wire.h>  
#include <Adafruit_GFX.h>  
#include <Adafruit_SSD1306.h>  
#include <Arduino.h>  
#include <ESP8266WiFi.h>  
#include <ESP8266WiFiMulti.h>  
#include <ESP8266HTTPClient.h>  
#include <WiFiClientSecure.h>  
ESP8266WiFiMulti WiFiMulti;  
#define SCREEN_WIDTH 128 // OLED display width, in pixels  
#define SCREEN_HEIGHT 64 // OLED display height, in pixels  
#define OLED_RESET   -1 // Reset pin # (or -1 if sharing Arduino reset pin)  
#define SCREEN_ADDRESS 0x3C ///< See datasheet for Address; 0x3D for 128x64, 0x3C for 128x32  
Adafruit_SSD1306 display(SCREEN_WIDTH, SCREEN_HEIGHT, &Wire, OLED_RESET);  
#define NUMFLAKES   10 // Number of snowflakes in the animation example  
#define LOGO_HEIGHT  32  
#define LOGO_WIDTH  32  
float v1=0;  
float p=0;  
String payload;  
const unsigned char bitcoinLogo [] PROGMEM =                 // 'Bitcoin Logo', 128x64px  
{  
 0x00, 0x00, 0x00, 0x00, 0x00, 0x00, 0x00, 0x00, 0x00, 0x00, 0x00, 0x00, 0x00, 0x00, 0x00, 0x00,   
 0x00, 0x00, 0x00, 0x00, 0x00, 0x00, 0x00, 0x00, 0x00, 0x00, 0x00, 0x00, 0x00, 0x00, 0x00, 0x00,   
 0x00, 0x00, 0x00, 0x00, 0x00, 0x00, 0x00, 0x00, 0x00, 0x00, 0x00, 0x00, 0x00, 0x00, 0x00, 0x00,   
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 0x00, 0x00, 0x00, 0x00, 0x00, 0x00, 0x00, 0x00, 0x00, 0x00, 0x00, 0x00, 0x00, 0x00, 0x00, 0x00  
};  
void setup() {  
  pinMode(D5, OUTPUT);  
  pinMode(D6, OUTPUT);  
  // SSD1306_SWITCHCAPVCC = generate display voltage from 3.3V internally  
  if(!display.begin(SSD1306_SWITCHCAPVCC, SCREEN_ADDRESS)) {  
   Serial.println(F("SSD1306 allocation failed"));  
   for(;;); // Don't proceed, loop forever  
  }  
  Serial.begin(9600);  
  // Serial.setDebugOutput(true);  
  Serial.println();  
  Serial.println();  
  Serial.println();  
  for (uint8_t t = 4; t > 0; t--) {  
   Serial.printf("[SETUP] WAIT %d...\n", t);  
   Serial.flush();  
   delay(1000);  
  }  
  display.setTextColor(SSD1306_WHITE);   
  display.clearDisplay();                                //Clear the OLED display  
  display.setTextSize(1);  
  printCenter("Connecting to WiFi ...", 0, 25);  
  display.display();  
  delay(2000);  
  WiFi.mode(WIFI_STA);  
  WiFiMulti.addAP("ketehore", "12345678");  
  Serial.println("Attempting to connect to WiFi...");  
  unsigned long startAttemptTime = millis();  
  while (WiFiMulti.run() != WL_CONNECTED && millis() - startAttemptTime < 10000) {  
    delay(500);  
    Serial.print(".");  
  }
  display.clearDisplay();                                //Clear the OLED display  
  display.setTextSize(1);  
  if (WiFiMulti.run() == WL_CONNECTED) {  
    printCenter("Connected", 0, 25);  
    Serial.println("\nWiFi connected, IP: " + WiFi.localIP().toString());  
  } else {  
    printCenter("WiFi Failed", 0, 25);  
    Serial.println("\nWiFi connection failed");  
  }  
  display.display();  
  delay(2000);  
} 
void loop() {  
  Serial.println("Entering loop..."); 
  if ((WiFiMulti.run() == WL_CONNECTED)) { 
    Serial.println("WiFi is connected");  
    WiFiClientSecure client;
    client.setInsecure();  
    HTTPClient http;  
    Serial.print("[HTTP] begin...\n");  
    if (http.begin(client, "https://api.thingspeak.com/apps/thinghttp/send_request?api_key=QOLSGF53CWKRBUQ0")) { // HTTP  
    Serial.print("[HTTP] GET...\n");  
    // start connection and send HTTP header  
    int httpCode = http.GET();  
    // httpCode will be negative on error  
    if (httpCode > 0) {  
     // HTTP header has been send and Server response header has been handled  
     Serial.printf("[HTTP] GET... code: %d\n", httpCode);  
     // file found at server  
     if (httpCode == HTTP_CODE_OK || httpCode == HTTP_CODE_MOVED_PERMANENTLY) {  
       payload = http.getString();  
       Serial.println("Raw payload: " + payload);  
       String stringTwo = payload;  
       stringTwo.replace("$", "");  
       stringTwo.replace(",", "");  
       float value = stringTwo.toFloat();  
       Serial.println("Parsed value: " + String(value, 2));  
       if (value == 0) {  
         Serial.println("Error: Failed to parse price");  
       } 
       if (v1 == 0) {  
         v1 = value;  
       }  
       if (v1 != 0 && v1 != value) {  
         p = ((value - v1) * 100) / v1;  
         v1 = value;  
       }  
       Serial.println("Percentage: " + String(p, 2)); 
       payload = String(value, 2); // Format payload dengan 2 desimal
     } else {  
       String errorPayload = http.getString();  
       Serial.println("Error payload: " + errorPayload);  
       display.clearDisplay();  
       display.setTextSize(1);  
       printCenter("HTTP Error: " + String(httpCode), 0, 25);  
       display.display();  
       delay(2000);  
     } 
    } else {  
     Serial.printf("[HTTP] GET... failed, error: %s\n", http.errorToString(httpCode).c_str());  
    }  
    http.end();  
   } else {  
    Serial.printf("[HTTP} Unable to connect\n");  
   }  
  }  
  display.clearDisplay();                           //Clear the display  
  display.setTextColor(SSD1306_WHITE);                    //Set the text colour to white  
  display.drawBitmap(0, 0, bitcoinLogo, 128, 64, WHITE);               //Display bitmap from array  
  display.display();  
  display.clearDisplay();   
  delay(2000);  
  String BTCUSDPrice = payload;  
  display.clearDisplay();                                //Clear the OLED display  
  display.setTextSize(1);  
  printCenter("BTC/USD", 0, 5);   
                           //Display the comparison header  
  display.setTextSize(2);  
  printCenter("$" + BTCUSDPrice, 0, 25);  
  if(p > 0)  
  {  
   String str = "+ ";  
   str += p;  
   str += " % ^";  
   display.setTextSize(1);                                //Display the change percentage  
   printCenter(str, 0, 55);  
   digitalWrite(D6, HIGH);  
   digitalWrite(D5, LOW);  
  }  
  else  
  {  
   String str = " ";  
   str += p;  
   str += " % ";  
   display.setTextSize(1);                                //Display the change percentage  
   printCenter(str, 0, 55);  
   digitalWrite(D5, HIGH);  
   digitalWrite(D6, LOW);  
  }  
  display.display();  
  delay(20000);  
}  
void printCenter(const String buf, int x, int y)             //Function to centre the current price in the display width  
{  
  int16_t x1, y1;  
  uint16_t w, h;  
  display.getTextBounds(buf, x, y, &x1, &y1, &w, &h);           //Calculate string width  
  display.setCursor((x - w / 2) + (128 / 2), y);             //Set cursor to print string in centre  
  display.print(buf);                           //Display string  
}